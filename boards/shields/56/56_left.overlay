#include "56.dtsi"

&default_transform { // The matrix transform for this board is 6 columns over because the left half is 6 columns wide according to the matrix.
};

&kscan0 {
    compatible = "zmk,kscan-gpio-matrix";
       diode-direction = "col2row";
       wakeup-source;

    col-gpios
        = <&pro_micro 14 GPIO_ACTIVE_HIGH> // col1 in the schematic 111
        , <&pro_micro 21 GPIO_ACTIVE_HIGH> // col2 in the schematic 031
        , <&pro_micro 9 GPIO_ACTIVE_HIGH> // col3 in the schematic 106
        , <&pro_micro 19 GPIO_ACTIVE_HIGH> // col4 in the schematic 002
        , <&pro_micro 8 GPIO_ACTIVE_HIGH> // col5 in the schematic 104
        , <&pro_micro 10 GPIO_ACTIVE_HIGH> // col6 in the schematic 009
        ;

    row-gpios
        = <&pro_micro 18 (GPIO_ACTIVE_HIGH | GPIO_PULL_DOWN)> // Row 0 from the schematic file 115
        , <&pro_micro 7  (GPIO_ACTIVE_HIGH | GPIO_PULL_DOWN)> // Row 1 from the schematic file 011
        , <&pro_micro 5 (GPIO_ACTIVE_HIGH | GPIO_PULL_DOWN)> // Row 2 from the schematic file 024
        , <&pro_micro 2 (GPIO_ACTIVE_HIGH | GPIO_PULL_DOWN)> // Row 3 from the schematic file 017
        , <&pro_micro 4 (GPIO_ACTIVE_HIGH | GPIO_PULL_DOWN)> // Row 4 from the schematic file 022
        ;
};
