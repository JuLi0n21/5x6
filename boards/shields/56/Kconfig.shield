## boards/shields/56/Kconfig.shield
```kconfig
# Copyright (c) 2022 The ZMK Contributors
# SPDX-License-Identifier: MIT
config SHIELD_MY_BOARD
    def_bool $(shields_list_contains,56)

config SHIELD_MY_BOARD_LEFT
    def_bool $(shields_list_contains,56_left)

config SHIELD_MY_BOARD_RIGHT
    def_bool $(shields_list_contains,56_right)
```

## boards/shields/6x7kb/Kconfig.defconfig
```kconfig
# Copyright (c) 2022 The ZMK Contributors
# SPDX-License-Identifier: MIT
if SHIELD_MY_BOARD_LEFT

config ZMK_KEYBOARD_NAME
    default "67"

config ZMK_SPLIT_ROLE_CENTRAL
    default y

endif

if SHIELD_MY_BOARD_LEFT || SHIELD_MY_BOARD_RIGHT

config ZMK_SPLIT
    default y

endif
```

## boards/shields/6x7kb/Kconfig.shield
```kconfig
# Copyright (c) 2022 The ZMK Contributors
# SPDX-License-Identifier: MIT
config SHIELD_MY_BOARD
    def_bool $(shields_list_contains,67)

config SHIELD_MY_BOARD_LEFT
    def_bool $(shields_list_contains,67_left)

config SHIELD_MY_BOARD_RIGHT
    def_bool $(shields_list_contains,67_right)
```
