#include "56.dtsi" // Notice that the main dtsi files are included in the overlay.

&default_transform { 
};

&kscan0 {
    compatible = "zmk,kscan-gpio-matrix";
       diode-direction = "col2row";
       wakeup-source;

    col-gpios
        = <&pro_micro 19 GPIO_ACTIVE_HIGH> // 002
        , <&pro_micro 18 GPIO_ACTIVE_HIGH> // 115
        , <&pro_micro 14 GPIO_ACTIVE_HIGH> // 111
        , <&pro_micro 16 GPIO_ACTIVE_HIGH> // 010
        , <&pro_micro 7 GPIO_ACTIVE_HIGH> //  011
        , <&pro_micro 10 GPIO_ACTIVE_HIGH> // 009
        ;

    row-gpios
        = <&pro_micro 20 (GPIO_ACTIVE_HIGH | GPIO_PULL_DOWN)> // 029
        , <&pro_micro 15 (GPIO_ACTIVE_HIGH | GPIO_PULL_DOWN)> // 113
        , <&pro_micro 6 (GPIO_ACTIVE_HIGH | GPIO_PULL_DOWN)> // 100
        , <&pro_micro 8 (GPIO_ACTIVE_HIGH | GPIO_PULL_DOWN)> // 104
        , <&pro_micro 9 (GPIO_ACTIVE_HIGH | GPIO_PULL_DOWN)> // 106
        ;
};
