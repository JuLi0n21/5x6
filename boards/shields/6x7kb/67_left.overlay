#include "iris.dtsi"

&default_transform { // The matrix transform for this board is 6 columns over because the left half is 6 columns wide according to the matrix.
};

&kscan0 {
    col-gpios
        = <&nice_nano_v2 16 GPIO_ACTIVE_HIGH> // col1 in the schematic
        , <&nice_nano_v2 20 GPIO_ACTIVE_HIGH> // col2 in the schematic
        , <&nice_nano_v2 9 GPIO_ACTIVE_HIGH> // col3 in the schematic
        , <&nice_nano_v2 18 GPIO_ACTIVE_HIGH> // col4 in the schematic
        , <&nice_nano_v2 19 GPIO_ACTIVE_HIGH> // col5 in the schematic
        , <&nice_nano_v2 6 GPIO_ACTIVE_HIGH> // col6 in the schematic
        ;
};
